## ql-ol-sdk/ql-ol-kernel/msm-3.18/drivers/quectel-drivers/Kconfig
```kconfig
#
# Optional quectel drivers configuration
#

menu "Quectel optional drivers"

config QUECTEL_DRIVER
	bool "quectel driver"
	default y

if QUECTEL_DRIVER

config QL_LPM
	tristate "quectel lpm driver(Recommend)"
	default m
	---help---
	  Quectel lpm driver, refer to document.

config QSTART
	bool "QSTART"
	default y

config QTZONE
	bool "quectel trust zone support"
	default n
	---help---
	  Trust zone function, consult quectel engineer further.

config QSMD
	bool "QSMD"
	default n
	---help---
	  legacy

config QSMEM
	bool "QSMEM"
	default n
	---help---
	  legacy

config QRAWDATA
	bool "QRAWDATA"
	default y

config QFASTSHUTDOWN
	bool "QFASTSHUTDOWN"
	default y

config QTEE
	bool "Quectel QTEE Driver"
	default y
	---help---
	  Trust zone function, consult quectel engineer further.

config QFASTSHUTDOWN
	bool "QFASTSHUTDOWN"
	default y

endif
endmenu
```

## ql-ol-sdk/ql-ol-kernel/msm-3.18/drivers/staging/mt29f_spinand/Kconfig
```kconfig
config MTD_SPINAND_MT29F
	tristate "SPINAND Device Support for Micron MT29F and Winbond W25N01GW"
	depends on MTD_NAND && SPI
	help
	  This enables support for accessing SPI NAND flash devices including:
	  - Micron MT29F series
	  - Winbond W25N01GW (1Gbit, 1.8V)

	  If you have Micron or Winbond SPI NAND chip say yes.

	  If unsure, say no here.

config MTD_SPINAND_ONDIEECC
	bool "Use SPINAND internal ECC"
	depends on MTD_SPINAND_MT29F
	help
	  Internel ECC.
	  Enables Hardware ECC support for Micron SPI NAND.
```
